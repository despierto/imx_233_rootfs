## src/package/kobs-ng/Config.in
```kconfig
config BR2_PACKAGE_KOBS
	bool "kobs"
	help
            Writes i.MX233-style boot streams to a NAND Flash medium
            
```

## src/package/opkg/Config.in
```kconfig
config BR2_PACKAGE_OPKG
	bool "opkg"
	help
	  The Package Installer from openmoko
```
